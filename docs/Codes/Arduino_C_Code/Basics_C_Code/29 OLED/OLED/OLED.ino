/*  
 * 名称   : OLED
 * 功能   ：此程序实现OLED显示
 * 编译IDE：ARDUINO 2.3.3
 * 作者   : https://www.keyestudio.com/
 */
#include <SPI.h>
#include <Wire.h>
#include <Adafruit_GFX.h>
#include <Adafruit_SSD1306.h>

#define SCREEN_WIDTH 128  // OLED显示宽度，以像素为单位
#define SCREEN_HEIGHT 64  // OLED显示高度，以像素为单位

// 声明SSD1306显示器连接使用I2C
#define OLED_RESET -1  // 重置引脚#(或-1如果共享Arduino重置引脚)
#define SCREEN_ADDRESS 0x3C
Adafruit_SSD1306 display(SCREEN_WIDTH, SCREEN_HEIGHT, &Wire, OLED_RESET);

//位图数据
static const unsigned char PROGMEM sunfounderIcon[] = {
	0xff, 0xff, 0xff, 0xff, 0xff, 0xff, 0xff, 0xff, 0xff, 0xff, 0xff, 0xf8, 0x7f, 0xff, 0xff, 0xff, 
	0xff, 0xff, 0xff, 0xf0, 0x1f, 0xff, 0xff, 0xff, 0xff, 0xff, 0xff, 0xe0, 0x0f, 0xff, 0xff, 0xff, 
	0xff, 0xff, 0xff, 0xc0, 0x07, 0xff, 0xff, 0xff, 0xff, 0xff, 0xff, 0x80, 0x03, 0xff, 0xff, 0xff, 
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	0xff, 0xff, 0xff, 0xff, 0x0f, 0xff, 0xff, 0xff, 0xff, 0xff, 0xff, 0xff, 0xff, 0xff, 0xff, 0xff
};

void setup() {
  Serial.begin(9600);

  // 初始化OLED对象
  if (!display.begin(SSD1306_SWITCHCAPVCC, SCREEN_ADDRESS)) {
    Serial.println(F("SSD1306 allocation failed"));
    for (;;)
      ;
  }

  // 清除缓冲区.
  display.clearDisplay();

  // 显示文本
  display.setTextSize(1);       // 设置文本尺寸大小
  display.setTextColor(WHITE);  // 设置文本颜色
  display.setCursor(0, 28);     // 设置光标位置
  display.println("Hello world!");
  display.display();  // 在屏幕上显示内容
  delay(2000);
  display.clearDisplay();  // 清除屏幕

  // 显示反向文本
  display.setTextColor(BLACK, WHITE);  // “倒”文本
  display.setCursor(0, 28);
  display.println("Hello world!");
  display.display();
  delay(2000);
  display.clearDisplay();

  // 更改字体大小
  display.setTextColor(WHITE);
  display.setCursor(0, 24);
  display.setTextSize(2);
  display.println("Hello!");
  display.display();
  delay(2000);
  display.clearDisplay();

  // 显示数字
  display.setTextSize(1);
  display.setCursor(0, 28);
  display.println(123456789);
  display.display();
  delay(2000);
  display.clearDisplay();

  // 显示ASCII字符
  display.setCursor(0, 24);
  display.setTextSize(2);
  for (int i = 1; i < 8; i++) {
    display.write(i);
  }
  display.display();
  delay(2000);
  display.clearDisplay();

  // 滚动全屏
  display.setCursor(0, 0);
  display.setTextSize(1);
  display.println("Full");
  display.println("screen");
  display.println("scrolling!");
  display.display();
  display.startscrollright(0x00, 0x07);  // 向右滚动屏幕
  delay(5000);
  display.stopscroll();
  delay(1000);
  display.startscrollleft(0x00, 0x07);  // 向左滚动屏幕
  delay(5000);
  display.stopscroll();
  delay(1000);
  display.clearDisplay();

  // 滚动屏幕的一部分
  display.setCursor(0, 0);
  display.setTextSize(1);
  display.println("Scroll");
  display.println("some part");
  display.println("of the screen.");
  display.display();
  display.startscrollright(0x00, 0x00);  // 将屏幕的第一列向右滚动
  delay(4000);
  display.stopscroll();
  display.clearDisplay();

  // 显示位图
  display.drawBitmap(32, 0, sunfounderIcon, 64, 64, WHITE);
  display.display();
}

void loop() {
  
}